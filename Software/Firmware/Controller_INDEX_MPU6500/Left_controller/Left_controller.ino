/*
  Copyright 2021 HadesVR
  Permission is hereby granted, free of charge, to any person obtaining a copy of this software and associated documentation files (the "Software"),
  to deal in the Software without restriction, including without limitation the rights to use, copy, modify, merge, publish, distribute, sublicense,
  and/or sell copies of the Software, and to permit persons to whom the Software is furnished to do so, subject to the following conditions:

  The above copyright notice and this permission notice shall be included in all copies or substantial portions of the Software.

  THE SOFTWARE IS PROVIDED "AS IS", WITHOUT WARRANTY OF ANY KIND, EXPRESS OR IMPLIED,INCLUDING BUT NOT LIMITED TO
  THE WARRANTIES OF MERCHANTABILITY, FITNESS FOR A PARTICULAR PURPOSE AND NONINFRINGEMENT. IN NO EVENT SHALL THE
  AUTHORS OR COPYRIGHT HOLDERS BE LIABLE FOR ANY CLAIM, DAMAGES OR OTHER LIABILITY, WHETHER IN AN ACTION OF CONTRACT,
  TORT OR OTHERWISE, ARISING FROM, OUT OF OR IN CONNECTION WITH THE SOFTWARE OR THE USE OR OTHER DEALINGS IN THE SOFTWARE.
*/

#include <Wire.h>
#include <SPI.h>
#include <EEPROM.h>
#include "RF24.h"
#include "RegisterMap.h"

//==========================================================================================================
//************************************ USER CONFIGURABLE STUFF HERE*****************************************
//==========================================================================================================

#define MPU9250_ADDRESS     0x68            //ADO 0
#define CALPIN              5               //pin to start mag calibration at power on
//#define SERIAL_DEBUG

#define APin                4
#define BPin                3
#define SysPin              5
#define FingerIndexPin      1
#define FingerMiddlePin     6
#define FingerRingPin       7
#define FingerPinkyPin      8
#define TrackpadPin         A0
#define JoyXPin             A1
#define JoyYPin             A2
#define JoyClickPin         2
#define TriggerPin          A3
#define VbatPin             A6

#define BatLevelMax         968             //you need to find all of these values on your own
#define JoyXMin             237             //check on the utils folder for sketches and instructions
#define JoyXMax             935             //that help on getting these values
#define JoyYMin             190             //YOU NEED TO DO THIS FOR BOTH CONTROLLERS
#define JoyYMax             900             //if you use these values without changing them you MAY
#define JoyXDeadZoneMin     490             //get stick drift
#define JoyXDeadZoneMax     620
#define JoyYDeadZoneMin     420
#define JoyYDeadZoneMax     620

//uint64_t Pipe = 0xF0F0F0F0E1LL; //right
uint64_t Pipe = 0xF0F0F0F0D2LL; //left
//==========================================================================================================

float magQuat[4] {1, 0, 0, 0};

struct Calibration {
  int calDone;
  float magBias[3];
  float magScale[3];
};
bool calDone;
Calibration cal;


static int ret;
static uint8_t fifoCount = 0;
struct s_quat {
  float w, x, y, z;
};

union u_quat {
  struct s_quat _f;
  long _l[4];
} q;

float DMPquat[4];

static float mx, my, mz;
static short ax, ay, az;

enum class MFS { M14BITS, M16BITS }; // 0.6mG, 0.15mG per LSB
static float mRes;
MFS MFSSEL = MFS::M16BITS;

#define DMP_CODE_SIZE           (3062)
#define STARTADDRESS            0x0400
#define DMP_SAMPLE_RATE         (200)
const unsigned char dmp_memory[DMP_CODE_SIZE] PROGMEM = {
  /* bank # 0 */
  0x00, 0x00, 0x70, 0x00, 0x00, 0x00, 0x00, 0x24, 0x00, 0x00, 0x00, 0x02, 0x00, 0x03, 0x00, 0x00,
  0x00, 0x65, 0x00, 0x54, 0xff, 0xef, 0x00, 0x00, 0xfa, 0x80, 0x00, 0x0b, 0x12, 0x82, 0x00, 0x01,
  0x03, 0x0c, 0x30, 0xc3, 0x0e, 0x8c, 0x8c, 0xe9, 0x14, 0xd5, 0x40, 0x02, 0x13, 0x71, 0x0f, 0x8e,
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  0x3b, 0xb6, 0x7a, 0xe8, 0x00, 0x64, 0x00, 0x00, 0x00, 0xc8, 0x00, 0x00, 0x00, 0x00, 0x00, 0x00,
  /* bank # 1 */
  0x10, 0x00, 0x00, 0x00, 0x10, 0x00, 0xfa, 0x92, 0x10, 0x00, 0x22, 0x5e, 0x00, 0x0d, 0x22, 0x9f,
  0x00, 0x01, 0x00, 0x00, 0x00, 0x32, 0x00, 0x00, 0xff, 0x46, 0x00, 0x00, 0x63, 0xd4, 0x00, 0x00,
  0x10, 0x00, 0x00, 0x00, 0x04, 0xd6, 0x00, 0x00, 0x04, 0xcc, 0x00, 0x00, 0x04, 0xcc, 0x00, 0x00,
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  0x00, 0x00, 0x10, 0x00, 0x00, 0x2f, 0x00, 0x00, 0x00, 0x00, 0x01, 0xf4, 0x00, 0x00, 0x10, 0x00,
  /* bank # 2 */
  0x00, 0x28, 0x00, 0x00, 0xff, 0xff, 0x45, 0x81, 0xff, 0xff, 0xfa, 0x72, 0x00, 0x00, 0x00, 0x00,
  0x00, 0x00, 0x00, 0x00, 0x00, 0x44, 0x00, 0x05, 0x00, 0x05, 0xba, 0xc6, 0x00, 0x47, 0x78, 0xa2,
  0x00, 0x00, 0x00, 0x01, 0x00, 0x00, 0x00, 0x00, 0x00, 0x00, 0x06, 0x00, 0x00, 0x00, 0x00, 0x14,
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  0xff, 0xe5, 0x00, 0x00, 0x00, 0x00, 0x00, 0x00, 0x00, 0x00, 0x00, 0x00, 0x00, 0x00, 0x00, 0x00,
  /* bank # 3 */
  0x00, 0x00, 0x00, 0x01, 0x00, 0x00, 0x00, 0x00, 0x00, 0x01, 0x00, 0x00, 0x00, 0x00, 0x00, 0x00,
  0x00, 0x01, 0x80, 0x00, 0x00, 0x01, 0x80, 0x00, 0x00, 0x01, 0x80, 0x00, 0x00, 0x24, 0x26, 0xd3,
  0x00, 0x00, 0x00, 0x00, 0x00, 0x00, 0x00, 0x00, 0x00, 0x06, 0x00, 0x10, 0x00, 0x96, 0x00, 0x3c,
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  0x00, 0x00, 0x00, 0x00, 0x00, 0x00, 0x00, 0x00, 0x00, 0x00, 0x00, 0x00, 0x00, 0x00, 0x00, 0x00,

  /* bank # 4 */
  0xd8, 0xdc, 0xb4, 0xb8, 0xb0, 0xd8, 0xb9, 0xab, 0xf3, 0xf8, 0xfa, 0xb3, 0xb7, 0xbb, 0x8e, 0x9e,
  0xae, 0xf1, 0x32, 0xf5, 0x1b, 0xf1, 0xb4, 0xb8, 0xb0, 0x80, 0x97, 0xf1, 0xa9, 0xdf, 0xdf, 0xdf,
  0xaa, 0xdf, 0xdf, 0xdf, 0xf2, 0xaa, 0xc5, 0xcd, 0xc7, 0xa9, 0x0c, 0xc9, 0x2c, 0x97, 0xf1, 0xa9,
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  0x7d, 0x98, 0xa8, 0x0e, 0x16, 0x1e, 0xa2, 0x2c, 0x54, 0x7c, 0x92, 0xa4, 0xf0, 0x2c, 0x50, 0x78,
  /* bank # 5 */
  0xf1, 0x84, 0xa8, 0x98, 0xc4, 0xcd, 0xfc, 0xd8, 0x0d, 0xdb, 0xa8, 0xfc, 0x2d, 0xf3, 0xd9, 0xba,
  0xa6, 0xf8, 0xda, 0xba, 0xa6, 0xde, 0xd8, 0xba, 0xb2, 0xb6, 0x86, 0x96, 0xa6, 0xd0, 0xf3, 0xc8,
  0x41, 0xda, 0xa6, 0xc8, 0xf8, 0xd8, 0xb0, 0xb4, 0xb8, 0x82, 0xa8, 0x92, 0xf5, 0x2c, 0x54, 0x88,
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  0x21, 0xd1, 0xda, 0xa5, 0xf9, 0xf4, 0x17, 0xd9, 0xf1, 0xae, 0x8e, 0xd0, 0xc0, 0xc3, 0xae, 0x82,
  /* bank # 6 */
  0xc6, 0x84, 0xc3, 0xa8, 0x85, 0x95, 0xc8, 0xa5, 0x88, 0xf2, 0xc0, 0xf1, 0xf4, 0x01, 0x0e, 0xf1,
  0x8e, 0x9e, 0xa8, 0xc6, 0x3e, 0x56, 0xf5, 0x54, 0xf1, 0x88, 0x72, 0xf4, 0x01, 0x15, 0xf1, 0x98,
  0x45, 0x85, 0x6e, 0xf5, 0x8e, 0x9e, 0x04, 0x88, 0xf1, 0x42, 0x98, 0x5a, 0x8e, 0x9e, 0x06, 0x88,
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  0xf8, 0xd8, 0xb0, 0xb4, 0xb8, 0xd8, 0xad, 0x84, 0xf2, 0xc0, 0xdf, 0xf1, 0x8f, 0xcb, 0xc3, 0xa8,
  /* bank # 7 */
  0xb2, 0xb6, 0x86, 0x96, 0xc8, 0xc1, 0xcb, 0xc3, 0xf3, 0xb0, 0xb4, 0x88, 0x98, 0xa8, 0x21, 0xdb,
  0x71, 0x8d, 0x9d, 0x71, 0x85, 0x95, 0x21, 0xd9, 0xad, 0xf2, 0xfa, 0xd8, 0x85, 0x97, 0xa8, 0x28,
  0xd9, 0xf4, 0x08, 0xd8, 0xf2, 0x8d, 0x29, 0xda, 0xf4, 0x05, 0xd9, 0xf2, 0x85, 0xa4, 0xc2, 0xf2,
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  0xde, 0xd9, 0xd0, 0xf8, 0xf8, 0xf8, 0xdb, 0x55, 0xf8, 0xd8, 0xa8, 0x78, 0xda, 0xa0, 0xd0, 0xdf,
  /* bank # 8 */
  0xd9, 0xd0, 0xfa, 0xf8, 0xf8, 0xf8, 0xf8, 0xdb, 0x7d, 0xf8, 0xd8, 0x9c, 0xa8, 0x8c, 0xf5, 0x30,
  0xdb, 0x38, 0xd9, 0xd0, 0xde, 0xdf, 0xa0, 0xd0, 0xde, 0xdf, 0xd8, 0xa8, 0x48, 0xdb, 0x58, 0xd9,
  0xdf, 0xd0, 0xde, 0xa0, 0xdf, 0xd0, 0xde, 0xd8, 0xa8, 0x68, 0xdb, 0x70, 0xd9, 0xdf, 0xdf, 0xa0,
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  0xd8, 0xa1, 0x81, 0x94, 0xf8, 0x18, 0xf2, 0xb0, 0x89, 0xac, 0xc3, 0xc5, 0xc7, 0xf1, 0xd8, 0xb8,
  /* bank # 9 */
  0xb4, 0xb0, 0x97, 0x86, 0xa8, 0x31, 0x9b, 0x06, 0x99, 0x07, 0xab, 0x97, 0x28, 0x88, 0x9b, 0xf0,
  0x0c, 0x20, 0x14, 0x40, 0xb0, 0xb4, 0xb8, 0xf0, 0xa8, 0x8a, 0x9a, 0x28, 0x50, 0x78, 0xb7, 0x9b,
  0xa8, 0x29, 0x51, 0x79, 0x24, 0x70, 0x59, 0x44, 0x69, 0x38, 0x64, 0x48, 0x31, 0xf1, 0xbb, 0xab,
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  0xc8, 0xf8, 0xf9, 0xd9, 0xde, 0xd8, 0x93, 0x85, 0xf1, 0x4a, 0xb1, 0x83, 0xa3, 0x08, 0xb5, 0x83,
  /* bank # 10 */
  0x9a, 0x08, 0x10, 0xb7, 0x9f, 0x10, 0xd8, 0xf1, 0xb0, 0xba, 0xae, 0xb0, 0x8a, 0xc2, 0xb2, 0xb6,
  0x8e, 0x9e, 0xf1, 0xfb, 0xd9, 0xf4, 0x1d, 0xd8, 0xf9, 0xd9, 0x0c, 0xf1, 0xd8, 0xf8, 0xf8, 0xad,
  0x61, 0xd9, 0xae, 0xfb, 0xd8, 0xf4, 0x0c, 0xf1, 0xd8, 0xf8, 0xf8, 0xad, 0x19, 0xd9, 0xae, 0xfb,
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  0x2c, 0x87, 0x0c, 0xa7, 0x81, 0x97, 0x62, 0x93, 0xf0, 0x71, 0x71, 0x60, 0x85, 0x94, 0x01, 0x29,
  /* bank # 11 */
  0x51, 0x79, 0x90, 0xa5, 0xf1, 0x28, 0x4c, 0x6c, 0x87, 0x0c, 0x95, 0x18, 0x85, 0x78, 0xa3, 0x83,
  0x90, 0x28, 0x4c, 0x6c, 0x88, 0x6c, 0xd8, 0xf3, 0xa2, 0x82, 0x00, 0xf2, 0x10, 0xa8, 0x92, 0x19,
  0x80, 0xa2, 0xf2, 0xd9, 0x26, 0xd8, 0xf1, 0x88, 0xa8, 0x4d, 0xd9, 0x48, 0xd8, 0x96, 0xa8, 0x39,
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  0xa6, 0xd9, 0x00, 0xd8, 0xf1, 0xff
};

#define Mmode 0x06                    // 2 for 8 Hz, 6 for 100 Hz continuous magnetometer data read

#define IB_AClick           0x0001
#define IB_ATouch           0x0002
#define IB_BClick           0x0004
#define IB_BTouch           0x0008
#define IB_SYSClick         0x0010
#define IB_ThumbStickClick  0x0020
#define IB_TrackpadTouch    0x0040
#define IB_ThumbStickTouch  0x0080

struct ctrlData {
  int16_t qW;
  int16_t qX;
  int16_t qY;
  int16_t qZ;
  int16_t accX;
  int16_t accY;
  int16_t accZ;
  uint16_t BTN;
  uint8_t  trigg;
  int8_t  axisX;
  int8_t  axisY;
  int8_t  trackY;
  uint8_t  vBAT;
  uint8_t  fingerThumb;
  uint8_t  fingerIndex;
  uint8_t  fingerMiddle;
  uint8_t  fingerRing;
  uint8_t  fingerPinky;
  uint16_t Data;
};
ctrlData data;

int tracky;
int trackoutput;
int axisX;
int axisY;
bool joyTouch = false;

RF24 radio(9, 10); // CE, CSN on Blue Pill

void setup() {

    pinMode(APin, INPUT_PULLUP);
    pinMode(BPin, INPUT_PULLUP);
    pinMode(SysPin, INPUT_PULLUP);
    pinMode(JoyClickPin, INPUT_PULLUP);
    pinMode(TriggerPin, INPUT_PULLUP);

#ifdef SERIAL_DEBUG
  Serial.begin(38400);
  while (!Serial) {
    ;
  }
#endif
  radio.begin();
  radio.setPayloadSize(32);
  radio.setPALevel(RF24_PA_MAX);
  radio.setDataRate(RF24_2MBPS);
  radio.openWritingPipe(Pipe);
  radio.startListening();
  radio.setAutoAck(false);

  Wire.begin();

  if (readByte(MPU9250_ADDRESS, WHO_AM_I_MPU9250) == MPU9250_WHOAMI_DEFAULT_VALUE)
  {
    Serial.println("MPU6500 is online");
    initMPU();
    initDMP();
  }
  else
  {
    Serial.print("Could not connect to MPU6500: 0x");
    Serial.println(readByte(MPU9250_ADDRESS, WHO_AM_I_MPU9250), HEX);
    while (true) {
      ;
    }
  }

  //initialize controller data.
  data.qW = 1;
  data.qX = 0;
  data.qY = 0;
  data.qZ = 0;
  data.BTN = 0;
  data.trigg = 0;
  data.axisX = 0;
  data.axisY = 0;
  data.trackY = 0;
  data.vBAT = 0;
  data.fingerThumb = 0;
  data.fingerIndex = 0;
  data.fingerMiddle = 0;
  data.fingerRing = 0;
  data.fingerPinky = 0;
  data.Data = 0x4B3;

  /*
    data.Data |= 0x03;  //non diy index controller identifier
    data.Data |= 0x10;  //controller reports accelerometer values
    data.Data |= 0x20;  //controller does support hand tracking
    //data.Data |= 0x40;  //handtracking type is analog
    data.Data |= 0x80;  //controller color is blue (80 for blue 100 for green 200 for red)
    data.Data |= 0x400; //controller reports battery %
  */
}

void loop() {

  updateMPU();

#ifdef SERIAL_DEBUG
  Serial.print("qw: "); Serial.print(q._f.w); Serial.print(" qx: "); Serial.print(q._f.x); Serial.print(" qy: "); Serial.print(q._f.y); Serial.print(" qz: "); Serial.println(q._f.z);
#endif

  joyTouch = false;
  int btn = 0;
  tracky = analogRead(TrackpadPin);
  if (tracky > 560) {
    trackoutput = 1;
    btn |= IB_TrackpadTouch;
  }
  if (tracky < 300 && tracky > 100) {
    trackoutput = 0;
    btn |= IB_TrackpadTouch;
  }
  if (tracky == 0) {
    trackoutput = -1;
    btn |= IB_TrackpadTouch;
  }
  if (tracky < 550 && tracky > 400) {
    trackoutput = 0;
  }

  axisX = analogRead(JoyXPin);
  axisY = analogRead(JoyYPin);

  if (axisX > JoyXDeadZoneMax || axisX < JoyXDeadZoneMin) {
    if (axisX > JoyXMax) {
      axisX = JoyXMax;
    }
    if (axisX < JoyXMin) {
      axisX = JoyXMin;
    }
    data.axisX = -map(axisX, JoyXMin, JoyXMax, -127, 127);
    btn |= IB_ThumbStickTouch;
    joyTouch = true;
  } else {
    data.axisX = 0;
  }

  if (axisY > JoyYDeadZoneMax || axisY < JoyYDeadZoneMin) {
    if (axisY > JoyYMax) {
      axisY = JoyYMax;
    }
    if (axisY < JoyYMin) {
      axisY = JoyYMin;
    }
    data.axisY = map(axisY, JoyYMin, JoyYMax, -127, 127);
    btn |= IB_ThumbStickTouch;
    joyTouch = true;
  } else {
    data.axisY = 0;
  }


  if (analogRead(TriggerPin) < 1000) {
    data.trigg = map(analogRead(TriggerPin), 1024, 0, 0, 255);
    data.fingerIndex = map(analogRead(TriggerPin), 1024, 0, 0, 255);
  }
  else {
    data.trigg = 0;
    data.fingerIndex = 0;
  }


  if (!digitalRead(APin)) {
    btn |= IB_AClick;
    btn |= IB_ATouch;
  }
  if (!digitalRead(BPin)) {
    btn |= IB_BClick;
    btn |= IB_BTouch;
  }
  if (!digitalRead(SysPin)) {
    btn |= IB_SYSClick;
  }
  if (!digitalRead(JoyClickPin)) {
    btn |= IB_ThumbStickClick;
  }
  //  if (digitalRead(FingerIndexPin)) {
  //    data.fingerIndex = 255;
  //  }
  //  else {
  //    data.fingerIndex = 0;
  //  }
  if (digitalRead(FingerMiddlePin)) {
    data.fingerMiddle = 255;
  }
  else {
    data.fingerMiddle = 0;
  }
  if (digitalRead(FingerRingPin)) {
    data.fingerRing = 255;
  }
  else {
    data.fingerRing = 0;
  }
  if (digitalRead(FingerPinkyPin)) {
    data.fingerPinky = 255;
  }
  else {
    data.fingerPinky = 0;
  }


  data.BTN = btn;
  data.trackY = (trackoutput * 127);
  data.vBAT = (map(analogRead(VbatPin), 787, BatLevelMax, 0, 255));
  data.qW = (int16_t)(q._f.w * 32767.f);
  data.qX = (int16_t)(q._f.y * 32767.f);
  data.qY = (int16_t)(q._f.z * 32767.f);
  data.qZ = (int16_t)(q._f.x * 32767.f);
  data.accX = ax * 2048;
  data.accY = ay * 2048;
  data.accZ = az * 2048;

  radio.stopListening();
  radio.write(&data, sizeof(ctrlData));
  radio.startListening();
}


void initMPU()
{
  unsigned char data;
  // reset device
  writeByte(MPU9250_ADDRESS, PWR_MGMT_1, 0x80);
  // wake up device
  writeByte(MPU9250_ADDRESS, PWR_MGMT_1, 0x00); // Clear sleep mode bit (6), enable all sensors
  delay(100); // Wait for all registers to reset

  writeByte(MPU9250_ADDRESS, MPU_CONFIG, 0x03); //set lpf to 42hz

  // get stable time source
  writeByte(MPU9250_ADDRESS, PWR_MGMT_1, 0x01);  // Auto select clock source to be PLL gyroscope reference if ready else
  delay(200);

  //enable all sensors
  writeByte(MPU9250_ADDRESS, PWR_MGMT_2, 0x00);
  delay(200);

  data = 3 << 3; // 11 = 2000dps
  writeByte(MPU9250_ADDRESS, GYRO_CONFIG, data);

  data = 1 << 3; // 01 = 4g
  writeByte(MPU9250_ADDRESS, ACCEL_CONFIG, data);
  // Set sample rate = gyroscope output rate/(1 + SMPLRT_DIV)
  writeByte(MPU9250_ADDRESS, SMPLRT_DIV, 0x04);  // Use a 200 Hz rate; a rate consistent with the filter update rate


  data = 0x01;          //BIT_DRDY_EN
  writeByte(MPU9250_ADDRESS, INT_ENABLE, data);
  // Configure Interrupts and Bypass Enable
  // Set interrupt pin active high, push-pull, hold interrupt pin level HIGH until interrupt cleared,
  // clear on read of INT_STATUS, and enable I2C_BYPASS_EN so additional chips
  // can join the I2C bus and all can be controlled by the Arduino as master
  writeByte(MPU9250_ADDRESS, INT_PIN_CFG, 0x22);
  delay(100);
}

void initDMP()
{
  dmpLoadFirmware(DMP_CODE_SIZE, dmp_memory, STARTADDRESS, DMP_SAMPLE_RATE);
  ret = dmp_set_fifo_rate(200);
  ret = enableDMP();
  ret = dmp_enable_features();
}

void initAK8963(float * destination)
{
  // First extract the factory calibration for each magnetometer axis
  uint8_t rawData[3];  // x/y/z gyro calibration data stored here
  writeByte(AK8963_ADDRESS, AK8963_CNTL, 0x00); // Power down magnetometer
  delay(10);
  writeByte(AK8963_ADDRESS, AK8963_CNTL, 0x0F); // Enter Fuse ROM access mode
  delay(10);
  readBytes(AK8963_ADDRESS, AK8963_ASAX, 3, &rawData[0]);  // Read the x-, y-, and z-axis calibration values
  destination[0] =  (float)(rawData[0] - 128) / 256. + 1.; // Return x-axis sensitivity adjustment values, etc.
  destination[1] =  (float)(rawData[1] - 128) / 256. + 1.;
  destination[2] =  (float)(rawData[2] - 128) / 256. + 1.;
  writeByte(AK8963_ADDRESS, AK8963_CNTL, 0x00); // Power down magnetometer
  delay(10);
  // Configure the magnetometer for continuous read and highest resolution
  // set Mscale bit 4 to 1 (0) to enable 16 (14) bit resolution in CNTL register,
  // and enable continuous mode data acquisition Mmode (bits [3:0]), 0010 for 8 Hz and 0110 for 100 Hz sample rates
  writeByte(AK8963_ADDRESS, AK8963_CNTL, (uint8_t)MFSSEL << 4 | Mmode); // Set magnetometer data resolution and sample ODR
  delay(10);

  //  Serial.println("Calibration values: ");
  //  Serial.print("X-Axis sensitivity adjustment value "); Serial.println(destination[0], 2);
  //  Serial.print("Y-Axis sensitivity adjustment value "); Serial.println(destination[1], 2);
  //  Serial.print("Z-Axis sensitivity adjustment value "); Serial.println(destination[2], 2);
  //  Serial.print("X-Axis sensitivity offset value "); Serial.println(cal.magBias[0], 2);
  //  Serial.print("Y-Axis sensitivity offset value "); Serial.println(cal.magBias[1], 2);
  //  Serial.print("Z-Axis sensitivity offset value "); Serial.println(cal.magBias[2], 2);
}

void mpu_reset_fifo()
{
  unsigned char data;

  data = 0;

  //reset registers
  writeByte(MPU9250_ADDRESS, INT_ENABLE, data);

  writeByte(MPU9250_ADDRESS, FIFO_EN, data);

  writeByte(MPU9250_ADDRESS, USER_CTRL, data);

  //reset FIFO and DMP
  data = 0x04 | 0x08;   //BIT_FIFO_RST, BIT_DMP_RST
  writeByte(MPU9250_ADDRESS, USER_CTRL, data);

  delay(50);

  //Enable them
  data = 0x80 | 0x40;   //BIT_DMP_EN, BIT_FIFO_EN
  writeByte(MPU9250_ADDRESS, USER_CTRL, data);

  data = 0x02;          //BIT_DMP_INT_EN
  writeByte(MPU9250_ADDRESS, INT_ENABLE, data);

  data = 0;
  writeByte(MPU9250_ADDRESS, FIFO_EN, data);

}

int updateMPU()
{
  do {
    //Read DMP
    ret = readDMP(q._l);

    if (ret != 0) return ret;
  } while (fifoCount > 1);

  //Convert to float
#define QUAT_SENS       1073741824.f //2^30
  DMPquat[0] = (float)q._l[0] / (float)QUAT_SENS;
  DMPquat[1] = (float)q._l[1] / (float)QUAT_SENS;
  DMPquat[2] = (float)q._l[2] / (float)QUAT_SENS;
  DMPquat[3] = (float)q._l[3] / (float)QUAT_SENS;
  
  float tmp;
  
  q._f.w = magQuat[0] * DMPquat[0] - magQuat[3] * DMPquat[3];
  q._f.x = magQuat[0] * DMPquat[1] - magQuat[3] * DMPquat[2];
  q._f.y = magQuat[0] * DMPquat[2] + magQuat[3] * DMPquat[1];
  q._f.z = magQuat[0] * DMPquat[3] + magQuat[3] * DMPquat[0];

  tmp = invSqrt(q._f.w * q._f.w + q._f.x * q._f.x + q._f.y * q._f.y + q._f.z * q._f.z);
  q._f.w *= tmp;
  q._f.y *= tmp;
  q._f.x *= tmp;
  q._f.z *= tmp;
}

int readDMP(long *quat)
{
  unsigned short fifo_count;
  unsigned char fifo_data[32];
  unsigned char ii = 0;
  unsigned char tmp[2];
  short accel[3];

  /* Get a packet. */
  readBytes(MPU9250_ADDRESS, FIFO_COUNTH, 2, tmp);
  fifo_count = (tmp[0] << 8) | tmp[1];
  if (fifo_count < 28) {      //no packet available.
    fifoCount = 0;
    return 1;
  }
  if (fifo_count > (1024 >> 1)) {
    /* FIFO is 50% full, better check overflow bit. */
    readBytes(MPU9250_ADDRESS, INT_STATUS, 1, tmp);
    if (tmp[0] & 0x10) {      //if fifo overflow
      mpu_reset_fifo();       //reset fifo
      return 2;
    }
  }

  readBytes(MPU9250_ADDRESS, FIFO_R_W, 28, fifo_data);
  fifoCount = (uint8_t)(fifo_count / 28 - 1);

  /* Parse DMP packet. */

  quat[0] = ((long)fifo_data[0] << 24) | ((long)fifo_data[1] << 16) |
            ((long)fifo_data[2] << 8) | fifo_data[3];
  quat[1] = ((long)fifo_data[4] << 24) | ((long)fifo_data[5] << 16) |
            ((long)fifo_data[6] << 8) | fifo_data[7];
  quat[2] = ((long)fifo_data[8] << 24) | ((long)fifo_data[9] << 16) |
            ((long)fifo_data[10] << 8) | fifo_data[11];
  quat[3] = ((long)fifo_data[12] << 24) | ((long)fifo_data[13] << 16) |
            ((long)fifo_data[14] << 8) | fifo_data[15];
  ii += 16;

  ay = ((short)fifo_data[ii + 0] << 8) | fifo_data[ii + 1];
  ax = ((short)fifo_data[ii + 2] << 8) | fifo_data[ii + 3];
  az = ((short)fifo_data[ii + 4] << 8) | fifo_data[ii + 5];
  ii += 6;
  /*
    ax = (float)accel[1] * 4.0 / 32768.0;
    ay = (float)accel[0] * 4.0 / 32768.0;
    az = (float)accel[2] * 4.0 / 32768.0;
  */
  return 0;
}

int dmp_set_fifo_rate(unsigned short rate)
{
  const unsigned char regs_end[12] = {0xfe, 0xf2, 0xab,
                                      0xc4, 0xaa, 0xf1, 0xdf, 0xdf, 0xBB, 0xAF, 0xdf, 0xdf
                                     };
  unsigned short div;
  unsigned char tmp[8];

  if (rate > DMP_SAMPLE_RATE)
    return -1;
  div = DMP_SAMPLE_RATE / rate - 1;
  tmp[0] = (unsigned char)((div >> 8) & 0xFF);
  tmp[1] = (unsigned char)(div & 0xFF);
  if (mpu_write_mem(22 + 512, 2, tmp))
    return -1;
  if (mpu_write_mem(2753, 12, (unsigned char*)regs_end))
    return -1;

  return 0;
}

int enableDMP()
{
  unsigned char tmp;
  /* Disable data ready interrupt. */
  tmp = 0x00;
  writeByte(MPU9250_ADDRESS, INT_ENABLE, tmp);
  /* Remove FIFO elements. */
  tmp = 0;
  writeByte(MPU9250_ADDRESS, 0x23, tmp);
  /* Enable DMP interrupt. */
  tmp = 0x02;
  writeByte(MPU9250_ADDRESS, INT_ENABLE, tmp);

  mpu_reset_fifo();

  return 0;
}

int dmp_enable_features()
{
#define GYRO_SF             (46850825LL * 200 / DMP_SAMPLE_RATE)
  unsigned char tmp[10];

  /* TODO: All of these settings can probably be integrated into the default
     DMP image.
  */
  /* Set integration scale factor. */
  tmp[0] = (unsigned char)((GYRO_SF >> 24) & 0xFF);
  tmp[1] = (unsigned char)((GYRO_SF >> 16) & 0xFF);
  tmp[2] = (unsigned char)((GYRO_SF >> 8) & 0xFF);
  tmp[3] = (unsigned char)(GYRO_SF & 0xFF);
  mpu_write_mem(104, 4, tmp);

  /* Send sensor data to the FIFO. */
  tmp[0] = 0xA3;
  tmp[1] = 0xC0;
  tmp[2] = 0xC8;
  tmp[3] = 0xC2;
  tmp[4] = 0xC4;
  tmp[5] = 0xCC;
  tmp[6] = 0xC6;
  tmp[7] = 0xA3;
  tmp[8] = 0xA3;
  tmp[9] = 0xA3;
  mpu_write_mem(2727, 10, tmp);

  /* Send gesture data to the FIFO. */
  tmp[0] = 0xD8;
  mpu_write_mem(2742, 1, tmp);

  //enable DMP gyro CAL
  unsigned char regs1[9] = {0xb8, 0xaa, 0xb3, 0x8d, 0xb4, 0x98, 0x0d, 0x35, 0x5d};
  mpu_write_mem(1208, 9, regs1);

  tmp[0] = 0xB2;
  tmp[1] = 0x8B;
  tmp[2] = 0xB6;
  tmp[3] = 0x9B;

  mpu_write_mem(2722, 4, tmp);

  unsigned char regs2[4];

  regs2[0] = 0x20;
  regs2[1] = 0x28;
  regs2[2] = 0x30;
  regs2[3] = 0x38;

  mpu_write_mem(2718, 4, regs2);

  mpu_reset_fifo();

  return 0;
}

void dmpLoadFirmware(unsigned short length, const unsigned char *firmware, unsigned short start_addr, unsigned short sample_rate) {
  unsigned short ii;
  unsigned short this_write;
  int errCode;
  uint8_t *progBuffer;
  /* Must divide evenly into st->hw->bank_size to avoid bank crossings. */
#define LOAD_CHUNK  (16)
  unsigned char cur[LOAD_CHUNK], tmp[2];

  progBuffer = (uint8_t *)malloc(LOAD_CHUNK);
  for (ii = 0; ii < length; ii += this_write) {
    this_write = min(LOAD_CHUNK, length - ii);

    for (int progIndex = 0; progIndex < this_write; progIndex++)

      progBuffer[progIndex] = pgm_read_byte(firmware + ii + progIndex);


    mpu_write_mem(ii, this_write, progBuffer);

    mpu_read_mem(ii, this_write, cur);


    if (memcmp(progBuffer, cur, this_write)) {
      Serial.println("oh shit something's wrong with the DMP's firmware (memcmp)");
    }
  }

  /* Set program start address. */
  tmp[0] = start_addr >> 8;
  tmp[1] = start_addr & 0xFF;
  writeBytes(MPU9250_ADDRESS, 0x70, 2, tmp);

}

int mpu_write_mem(unsigned short mem_addr, unsigned short length,
                  unsigned char *data)
{
  unsigned char tmp[2];

  if (!data)
    return -1;

  tmp[0] = (unsigned char)(mem_addr >> 8);
  tmp[1] = (unsigned char)(mem_addr & 0xFF);

  /* Check bank boundaries. */
  if (tmp[1] + length > 256)
    return -2;


  writeBytes(MPU9250_ADDRESS, 0x6D, 2, tmp);

  writeBytes(MPU9250_ADDRESS, 0x6F, length, data);

  return 0;
}

int mpu_read_mem(unsigned short mem_addr, unsigned short length,
                 unsigned char *data)
{
  unsigned char tmp[2];

  if (!data)
    return -1;

  tmp[0] = (unsigned char)(mem_addr >> 8);
  tmp[1] = (unsigned char)(mem_addr & 0xFF);

  /* Check bank boundaries. */
  if (tmp[1] + length > 256)
    return -2;

  writeBytes(MPU9250_ADDRESS, 0x6D, 2, tmp);

  readBytes(MPU9250_ADDRESS, 0x6F, length, data);

  return 0;
}

uint8_t readByte(uint8_t address, uint8_t subAddress)
{
  uint8_t data; // `data` will store the register data
  Wire.beginTransmission(address);         // Initialize the Tx buffer
  Wire.write(subAddress);                  // Put slave register address in Tx buffer
  Wire.endTransmission(false);             // Send the Tx buffer, but send a restart to keep connection alive
  Wire.requestFrom(address, (uint8_t) 1);  // Read one byte from slave register address
  data = Wire.read();                      // Fill Rx buffer with result
  return data;                             // Return data read from slave register
}

void readBytes(uint8_t address, uint8_t subAddress, uint8_t count, uint8_t * dest)
{
  Wire.beginTransmission(address);   // Initialize the Tx buffer
  Wire.write(subAddress);            // Put slave register address in Tx buffer
  Wire.endTransmission(false);       // Send the Tx buffer, but send a restart to keep connection alive
  uint8_t i = 0;
  Wire.requestFrom(address, count);  // Read bytes from slave register address
  while (Wire.available()) {
    dest[i++] = Wire.read();
  }         // Put read results in the Rx buffer
}

void writeByte(uint8_t address, uint8_t subAddress, uint8_t data)
{
  Wire.beginTransmission(address);  // Initialize the Tx buffer
  Wire.write(subAddress);           // Put slave register address in Tx buffer
  Wire.write(data);                 // Put data in Tx buffer
  Wire.endTransmission();           // Send the Tx buffer
}

void writeBytes(uint8_t address, uint8_t subAddress, uint8_t count, uint8_t* data) {

  Wire.beginTransmission(address);
  Wire.write((uint8_t) subAddress); // send address
  for (uint8_t i = 0; i < count; i++) {
    Wire.write((uint8_t) data[i]);
  }
  Wire.endTransmission();
}
//fast invsqrt
float invSqrt(float x) {
  float halfx = 0.5f * x;
  float y = x;
  long i = *(long*)&y;
  i = 0x5f3759df - (i >> 1);
  y = *(float*)&i;
  y = y * (1.5f - (halfx * y * y));
  y = y * (1.5f - (halfx * y * y));
  return y;
}
